## conf/layer.conf
```bitbake
# We have a conf and classes directory, add to BBPATH
BBPATH .= ":${LAYERDIR}"

# We have recipes-* directories, add to BBFILES
BBFILES += "${LAYERDIR}/recipes-*/*/*.bb \
            ${LAYERDIR}/recipes-*/*/*.bbappend"

BBFILE_COLLECTIONS += "meta-xt-qcom"
BBFILE_PATTERN_meta-xt-qcom = "^${LAYERDIR}/"
BBFILE_PRIORITY_meta-xt-qcom = "6"

LAYERDEPENDS_meta-xt-qcom = "core"
LAYERSERIES_COMPAT_meta-xt-qcom = "kirkstone"
```

## conf/machine/sa8155p-adp.conf
```bitbake
#@TYPE: Machine
#@NAME: SA8155P-ADP machine
#@DESCRIPTION: Configuration for SA8155P Automotive Development Platform. Xen-Troops variant.

MACHINE_EXTRA_RRECOMMENDS = "kernel-modules kernel-devicetree"

DEFAULTTUNE ?= "cortexa73-cortexa53"
include conf/machine/include/arm/armv8a/tune-cortexa73-cortexa53.inc

IMAGE_FSTYPES += "tar.bz2 ext4"
MACHINE_ESSENTIAL_EXTRA_RDEPENDS += "kernel-image kernel-devicetree"
# UFS has sectors size of 4096 bytes
EXTRA_IMAGECMD:ext4:append = " -b 4096"

SERIAL_CONSOLES ?= "115200;ttyMSM0 115200;hvc"
SERIAL_CONSOLES_CHECK = "${SERIAL_CONSOLES}"

PREFERRED_PROVIDER_virtual/kernel ?= "linux-yocto"

KERNEL_IMAGETYPE = "Image"
KERNEL_DEVICETREE = ""
```
